## conf/layer.conf
```bitbake
# We have a conf and classes directory, add to BBPATH
BBPATH .= ":${LAYERDIR}"

# We have recipes-* directories, add to BBFILES
BBFILES += "${LAYERDIR}/recipes-*/*/*.bb \
            ${LAYERDIR}/recipes-*/*/*.bbappend"

BBFILE_COLLECTIONS += "meta-python2-backport"
BBFILE_PATTERN_meta-python2-backport = "^${LAYERDIR}/"
BBFILE_PRIORITY_meta-python2-backport = "5"

LAYERDEPENDS_meta-python2-backport = "core meta-python2"
LAYERVERSION_meta-python2-backport = "1"
LAYERSERIES_COMPAT_meta-python2-backport = "dunfell
```
